## build/Kconfig/soc/Kconfig.sysbuild
```kconfig
# Load Sysbuild SoC Kconfig descriptions.
osource "/home/wojtess/Documents/put/pico/project1/.zephyr/zephyr/soc/xlnx/zynqmp/Kconfig.sysbuild"
osource "/home/wojtess/Documents/put/pico/project1/.zephyr/zephyr/soc/xlnx/zynq7000/Kconfig.sysbuild"
osource "/home/wojtess/Documents/put/pico/project1/.zephyr/zephyr/soc/xlnx/versalnet/Kconfig.sysbuild"
osource "/home/wojtess/Documents/put/pico/project1/.zephyr/zephyr/soc/xlnx/versal2/Kconfig.sysbuild"
osource "/home/wojtess/Documents/put/pico/project1/.zephyr/zephyr/soc/xlnx/versal/Kconfig.sysbuild"
osource "/home/wojtess/Documents/put/pico/project1/.zephyr/zephyr/soc/xen/Kconfig.sysbuild"
osource "/home/wojtess/Documents/put/pico/project1/.zephyr/zephyr/soc/wch/ch32v/Kconfig.sysbuild"
osource "/home/wojtess/Documents/put/pico/project1/.zephyr/zephyr/soc/ti/simplelink/Kconfig.sysbuild"
osource "/home/wojtess/Documents/put/pico/project1/.zephyr/zephyr/soc/ti/mspm0/Kconfig.sysbuild"
osource "/home/wojtess/Documents/put/pico/project1/.zephyr/zephyr/soc/ti/lm3s6965/Kconfig.sysbuild"
osource "/home/wojtess/Documents/put/pico/project1/.zephyr/zephyr/soc/ti/k3/Kconfig.sysbuild"
osource "/home/wojtess/Documents/put/pico/project1/.zephyr/zephyr/soc/telink/tlsr/Kconfig.sysbuild"
osource "/home/wojtess/Documents/put/pico/project1/.zephyr/zephyr/soc/starfive/jh71xx/Kconfig.sysbuild"
osource "/home/wojtess/Documents/put/pico/project1/.zephyr/zephyr/soc/st/stm32/Kconfig.sysbuild"
osource "/home/wojtess/Documents/put/pico/project1/.zephyr/zephyr/soc/snps/qemu_arc/Kconfig.sysbuild"
osource "/home/wojtess/Documents/put/pico/project1/.zephyr/zephyr/soc/snps/nsim/arc_v/Kconfig.sysbuild"
osource "/home/wojtess/Documents/put/pico/project1/.zephyr/zephyr/soc/snps/nsim/arc_classic/Kconfig.sysbuild"
osource "/home/wojtess/Documents/put/pico/project1/.zephyr/zephyr/soc/snps/hsdk4xd/Kconfig.sysbuild"
osource "/home/wojtess/Documents/put/pico/project1/.zephyr/zephyr/soc/snps/hsdk/Kconfig.sysbuild"
osource "/home/wojtess/Documents/put/pico/project1/.zephyr/zephyr/soc/snps/emsk/Kconfig.sysbuild"
osource "/home/wojtess/Documents/put/pico/project1/.zephyr/zephyr/soc/snps/emsdp/Kconfig.sysbuild"
osource "/home/wojtess/Documents/put/pico/project1/.zephyr/zephyr/soc/snps/arc_iot/Kconfig.sysbuild"
osource "/home/wojtess/Documents/put/pico/project1/.zephyr/zephyr/soc/silabs/Kconfig.sysbuild"
osource "/home/wojtess/Documents/put/pico/project1/.zephyr/zephyr/soc/sifli/sf32/Kconfig.sysbuild"
osource "/home/wojtess/Documents/put/pico/project1/.zephyr/zephyr/soc/sifive/sifive_freedom/Kconfig.sysbuild"
osource "/home/wojtess/Documents/put/pico/project1/.zephyr/zephyr/soc/sensry/Kconfig.sysbuild"
osource "/home/wojtess/Documents/put/pico/project1/.zephyr/zephyr/soc/rockchip/Kconfig.sysbuild"
osource "/home/wojtess/Documents/put/pico/project1/.zephyr/zephyr/soc/renode/riscv_virtual/Kconfig.sysbuild"
osource "/home/wojtess/Documents/put/pico/project1/.zephyr/zephyr/soc/renode/cortex_r8_virtual/Kconfig.sysbuild"
osource "/home/wojtess/Documents/put/pico/project1/.zephyr/zephyr/soc/renesas/smartbond/Kconfig.sysbuild"
osource "/home/wojtess/Documents/put/pico/project1/.zephyr/zephyr/soc/renesas/rz/Kconfig.sysbuild"
osource "/home/wojtess/Documents/put/pico/project1/.zephyr/zephyr/soc/renesas/rx/Kconfig.sysbuild"
osource "/home/wojtess/Documents/put/pico/project1/.zephyr/zephyr/soc/renesas/rcar/Kconfig.sysbuild"
osource "/home/wojtess/Documents/put/pico/project1/.zephyr/zephyr/soc/renesas/ra/Kconfig.sysbuild"
osource "/home/wojtess/Documents/put/pico/project1/.zephyr/zephyr/soc/realtek/ec/Kconfig.sysbuild"
osource "/home/wojtess/Documents/put/pico/project1/.zephyr/zephyr/soc/realtek/ameba/Kconfig.sysbuild"
osource "/home/wojtess/Documents/put/pico/project1/.zephyr/zephyr/soc/raspberrypi/rpi_pico/Kconfig.sysbuild"
osource "/home/wojtess/Documents/put/pico/project1/.zephyr/zephyr/soc/quicklogic/eos_s3/Kconfig.sysbuild"
osource "/home/wojtess/Documents/put/pico/project1/.zephyr/zephyr/soc/qemu/virt_riscv/Kconfig.sysbuild"
osource "/home/wojtess/Documents/put/pico/project1/.zephyr/zephyr/soc/qemu/malta/Kconfig.sysbuild"
osource "/home/wojtess/Documents/put/pico/project1/.zephyr/zephyr/soc/openisa/rv32m1/Kconfig.sysbuild"
osource "/home/wojtess/Documents/put/pico/project1/.zephyr/zephyr/soc/openhwgroup/cva6/Kconfig.sysbuild"
osource "/home/wojtess/Documents/put/pico/project1/.zephyr/zephyr/soc/oct/osd32mp15x/Kconfig.sysbuild"
osource "/home/wojtess/Documents/put/pico/project1/.zephyr/zephyr/soc/nxp/s32/Kconfig.sysbuild"
osource "/home/wojtess/Documents/put/pico/project1/.zephyr/zephyr/soc/nxp/rw/Kconfig.sysbuild"
osource "/home/wojtess/Documents/put/pico/project1/.zephyr/zephyr/soc/nxp/mcx/Kconfig.sysbuild"
osource "/home/wojtess/Documents/put/pico/project1/.zephyr/zephyr/soc/nxp/lpc/Kconfig.sysbuild"
osource "/home/wojtess/Documents/put/pico/project1/.zephyr/zephyr/soc/nxp/layerscape/Kconfig.sysbuild"
osource "/home/wojtess/Documents/put/pico/project1/.zephyr/zephyr/soc/nxp/kinetis/Kconfig.sysbuild"
osource "/home/wojtess/Documents/put/pico/project1/.zephyr/zephyr/soc/nxp/imxrt/Kconfig.sysbuild"
osource "/home/wojtess/Documents/put/pico/project1/.zephyr/zephyr/soc/nxp/imx/Kconfig.sysbuild"
osource "/home/wojtess/Documents/put/pico/project1/.zephyr/zephyr/soc/nuvoton/numicro/Kconfig.sysbuild"
osource "/home/wojtess/Documents/put/pico/project1/.zephyr/zephyr/soc/nuvoton/numaker/Kconfig.sysbuild"
osource "/home/wojtess/Documents/put/pico/project1/.zephyr/zephyr/soc/nuvoton/npcx/Kconfig.sysbuild"
osource "/home/wojtess/Documents/put/pico/project1/.zephyr/zephyr/soc/nuvoton/npcm/Kconfig.sysbuild"
osource "/home/wojtess/Documents/put/pico/project1/.zephyr/zephyr/soc/nordic/Kconfig.sysbuild"
osource "/home/wojtess/Documents/put/pico/project1/.zephyr/zephyr/soc/neorv32/Kconfig.sysbuild"
osource "/home/wojtess/Documents/put/pico/project1/.zephyr/zephyr/soc/native/inf_clock/Kconfig.sysbuild"
osource "/home/wojtess/Documents/put/pico/project1/.zephyr/zephyr/soc/microchip/sam/sama7/Kconfig.sysbuild"
osource "/home/wojtess/Documents/put/pico/project1/.zephyr/zephyr/soc/microchip/sam/sam_d5x_e5x/Kconfig.sysbuild"
osource "/home/wojtess/Documents/put/pico/project1/.zephyr/zephyr/soc/microchip/pic64/Kconfig.sysbuild"
osource "/home/wojtess/Documents/put/pico/project1/.zephyr/zephyr/soc/microchip/pic32c/pic32cz_ca/Kconfig.sysbuild"
osource "/home/wojtess/Documents/put/pico/project1/.zephyr/zephyr/soc/microchip/pic32c/pic32cx_sg/Kconfig.sysbuild"
osource "/home/wojtess/Documents/put/pico/project1/.zephyr/zephyr/soc/microchip/pic32c/pic32cm_jh/Kconfig.sysbuild"
osource "/home/wojtess/Documents/put/pico/project1/.zephyr/zephyr/soc/microchip/miv/Kconfig.sysbuild"
osource "/home/wojtess/Documents/put/pico/project1/.zephyr/zephyr/soc/microchip/mec/Kconfig.sysbuild"
osource "/home/wojtess/Documents/put/pico/project1/.zephyr/zephyr/soc/mediatek/mt8xxx/Kconfig.sysbuild"
osource "/home/wojtess/Documents/put/pico/project1/.zephyr/zephyr/soc/lowrisc/opentitan/Kconfig.sysbuild"
osource "/home/wojtess/Documents/put/pico/project1/.zephyr/zephyr/soc/litex/litex_vexriscv/Kconfig.sysbuild"
osource "/home/wojtess/Documents/put/pico/project1/.zephyr/zephyr/soc/ite/ec/Kconfig.sysbuild"
osource "/home/wojtess/Documents/put/pico/project1/.zephyr/zephyr/soc/intel/wildcat_lake/Kconfig.sysbuild"
osource "/home/wojtess/Documents/put/pico/project1/.zephyr/zephyr/soc/intel/raptor_lake/Kconfig.sysbuild"
osource "/home/wojtess/Documents/put/pico/project1/.zephyr/zephyr/soc/intel/panther_lake/Kconfig.sysbuild"
osource "/home/wojtess/Documents/put/pico/project1/.zephyr/zephyr/soc/intel/lakemont/Kconfig.sysbuild"
osource "/home/wojtess/Documents/put/pico/project1/.zephyr/zephyr/soc/intel/intel_socfpga_std/Kconfig.sysbuild"
osource "/home/wojtess/Documents/put/pico/project1/.zephyr/zephyr/soc/intel/intel_socfpga/Kconfig.sysbuild"
osource "/home/wojtess/Documents/put/pico/project1/.zephyr/zephyr/soc/intel/intel_niosv/Kconfig.sysbuild"
osource "/home/wojtess/Documents/put/pico/project1/.zephyr/zephyr/soc/intel/intel_ish/Kconfig.sysbuild"
osource "/home/wojtess/Documents/put/pico/project1/.zephyr/zephyr/soc/intel/intel_adsp/Kconfig.sysbuild"
osource "/home/wojtess/Documents/put/pico/project1/.zephyr/zephyr/soc/intel/elkhart_lake/Kconfig.sysbuild"
osource "/home/wojtess/Documents/put/pico/project1/.zephyr/zephyr/soc/intel/atom/Kconfig.sysbuild"
osource "/home/wojtess/Documents/put/pico/project1/.zephyr/zephyr/soc/intel/apollo_lake/Kconfig.sysbuild"
osource "/home/wojtess/Documents/put/pico/project1/.zephyr/zephyr/soc/intel/alder_lake/Kconfig.sysbuild"
osource "/home/wojtess/Documents/put/pico/project1/.zephyr/zephyr/soc/infineon/psoc4/Kconfig.sysbuild"
osource "/home/wojtess/Documents/put/pico/project1/.zephyr/zephyr/soc/infineon/edge/Kconfig.sysbuild"
osource "/home/wojtess/Documents/put/pico/project1/.zephyr/zephyr/soc/infineon/cat3/Kconfig.sysbuild"
osource "/home/wojtess/Documents/put/pico/project1/.zephyr/zephyr/soc/infineon/cat1c/Kconfig.sysbuild"
osource "/home/wojtess/Documents/put/pico/project1/.zephyr/zephyr/soc/infineon/cat1b/Kconfig.sysbuild"
osource "/home/wojtess/Documents/put/pico/project1/.zephyr/zephyr/soc/infineon/cat1a/Kconfig.sysbuild"
osource "/home/wojtess/Documents/put/pico/project1/.zephyr/zephyr/soc/gd/gd32/Kconfig.sysbuild"
osource "/home/wojtess/Documents/put/pico/project1/.zephyr/zephyr/soc/gaisler/leon3/Kconfig.sysbuild"
osource "/home/wojtess/Documents/put/pico/project1/.zephyr/zephyr/soc/gaisler/gr716a/Kconfig.sysbuild"
osource "/home/wojtess/Documents/put/pico/project1/.zephyr/zephyr/soc/focaltech/Kconfig.sysbuild"
osource "/home/wojtess/Documents/put/pico/project1/.zephyr/zephyr/soc/espressif/Kconfig.sysbuild"
osource "/home/wojtess/Documents/put/pico/project1/.zephyr/zephyr/soc/ene/kb1200/Kconfig.sysbuild"
osource "/home/wojtess/Documents/put/pico/project1/.zephyr/zephyr/soc/ene/kb106x/Kconfig.sysbuild"
osource "/home/wojtess/Documents/put/pico/project1/.zephyr/zephyr/soc/elan/em32f967/Kconfig.sysbuild"
osource "/home/wojtess/Documents/put/pico/project1/.zephyr/zephyr/soc/egis/Kconfig.sysbuild"
osource "/home/wojtess/Documents/put/pico/project1/.zephyr/zephyr/soc/efinix/sapphire/Kconfig.sysbuild"
osource "/home/wojtess/Documents/put/pico/project1/.zephyr/zephyr/soc/cdns/xtensa_sample_controller/Kconfig.sysbuild"
osource "/home/wojtess/Documents/put/pico/project1/.zephyr/zephyr/soc/cdns/sample_controller32/Kconfig.sysbuild"
osource "/home/wojtess/Documents/put/pico/project1/.zephyr/zephyr/soc/cdns/dc233c/Kconfig.sysbuild"
osource "/home/wojtess/Documents/put/pico/project1/.zephyr/zephyr/soc/brcm/bcmvk/Kconfig.sysbuild"
osource "/home/wojtess/Documents/put/pico/project1/.zephyr/zephyr/soc/brcm/bcm2712/Kconfig.sysbuild"
osource "/home/wojtess/Documents/put/pico/project1/.zephyr/zephyr/soc/brcm/bcm2711/Kconfig.sysbuild"
osource "/home/wojtess/Documents/put/pico/project1/.zephyr/zephyr/soc/blackberry/qnxhv_vm/Kconfig.sysbuild"
osource "/home/wojtess/Documents/put/pico/project1/.zephyr/zephyr/soc/bflb/Kconfig.sysbuild"
osource "/home/wojtess/Documents/put/pico/project1/.zephyr/zephyr/soc/atmel/sam0/Kconfig.sysbuild"
osource "/home/wojtess/Documents/put/pico/project1/.zephyr/zephyr/soc/atmel/sam/Kconfig.sysbuild"
osource "/home/wojtess/Documents/put/pico/project1/.zephyr/zephyr/soc/aspeed/Kconfig.sysbuild"
osource "/home/wojtess/Documents/put/pico/project1/.zephyr/zephyr/soc/arm/Kconfig.sysbuild"
osource "/home/wojtess/Documents/put/pico/project1/.zephyr/zephyr/soc/arm/beetle/Kconfig.sysbuild"
osource "/home/wojtess/Documents/put/pico/project1/.zephyr/zephyr/soc/antmicro/myra/Kconfig.sysbuild"
osource "/home/wojtess/Documents/put/pico/project1/.zephyr/zephyr/soc/andestech/Kconfig.sysbuild"
osource "/home/wojtess/Documents/put/pico/project1/.zephyr/zephyr/soc/amd/acp_6_0/Kconfig.sysbuild"
osource "/home/wojtess/Documents/put/pico/project1/.zephyr/zephyr/soc/ambiq/Kconfig.sysbuild"
osource "/home/wojtess/Documents/put/pico/project1/.zephyr/zephyr/soc/allwinner/sun8i_h3/Kconfig.sysbuild"
osource "/home/wojtess/Documents/put/pico/project1/.zephyr/zephyr/soc/aesc/Kconfig.sysbuild"
osource "/home/wojtess/Documents/put/pico/project1/.zephyr/zephyr/soc/adi/max32/Kconfig.sysbuild"
```

## src/modules/adc_reader/Kconfig
```kconfig
# ADC reader module configuration

config ADC_READER
	bool "Enable ADC reader module"
	default y
	help
	Single-source ADC reader for P-controller and streaming.
	Reads ADC periodically and provides shared value to consumers.

	Benefits:
	- No race condition on ADC peripheral
	- No duplicated ADC reads
	- Consistent ADC values across all consumers
	- Reduced CPU overhead
```

## src/modules/p_controller/Kconfig
```kconfig
# P-controller module configuration options

config P_CONTROLLER
    bool "Enable P-controller module"
    default y
    help
        P-controller for current regulation with manual/auto mode switching.
        Control loop runs at 1 kHz (1ms interval) and supports:
        - MANUAL mode: Direct PWM control
        - AUTO mode: Automatic P-control based on ADC feedback

        Formula: PWM = feed_forward + (Kp * (setpoint - measured)) / 100
```
